// SPDX-License-Identifier: BSD-3-Clause
/*
 * Copyright (c) Qualcomm Technologies, Inc. and/or its subsidiaries.
 */

/dts-v1/;
/plugin/;

#include <dt-bindings/clock/qcom,aop-qmp.h>
#include <dt-bindings/clock/qcom,gcc-seraph.h>
#include <dt-bindings/clock/qcom,gpucc-seraph.h>
#include <dt-bindings/clock/qcom,rpmh.h>
#include <dt-bindings/interconnect/qcom,seraph.h>
#include <dt-bindings/interrupt-controller/arm-gic.h>
#include <dt-bindings/regulator/qcom,rpmh-regulator-levels.h>
#include <dt-bindings/interrupt-controller/arm-gic.h>

#include "seraph-gpu.dtsi"
#include "seraph-gpu-pwrlevels.dtsi"

/ {
	model = "Qualcomm Technologies, Inc. Seraph SoC";
	compatible = "qcom,seraph";
	qcom,msm-id = <0x2a0 0x10000>, <0x2a1 0x10000>;
	qcom,board-id = <0 0>;
};
