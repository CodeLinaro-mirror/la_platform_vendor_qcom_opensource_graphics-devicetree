// SPDX-License-Identifier: BSD-3-Clause
/*
 * Copyright (c) Qualcomm Technologies, Inc. and/or its subsidiaries.
 */

#include "waipio-gpu.dtsi"

&msm_gpu {
	compatible = "qcom,adreno-gpu-gen7-0-1", "qcom,kgsl-3d0";

	qcom,initial-pwrlevel = <9>;

	qcom,gpu-model = "Adreno730v2";

	qcom,chipid = <0x07030001>;
};
