// SPDX-License-Identifier: BSD-3-Clause
/*
 * Copyright (c) Qualcomm Technologies, Inc. and/or its subsidiaries.
 */

/dts-v1/;
/plugin/;

#include <dt-bindings/clock/qcom,aop-qmp.h>
#include <dt-bindings/clock/qcom,art-gcc.h>
#include <dt-bindings/clock/qcom,art-gpucc.h>
#include <dt-bindings/clock/qcom,art-gxclkctl.h>
#include <dt-bindings/clock/qcom,rpmh.h>
#include <dt-bindings/interconnect/qcom,art.h>
#include <dt-bindings/interrupt-controller/arm-gic.h>
#include <dt-bindings/regulator/qcom,rpmh-regulator-levels.h>

#include "art-gpu.dtsi"
#include "art-gpu-pwrlevels.dtsi"

/ {
	model = "Qualcomm Technologies, Inc. Art SoC";
	compatible = "qcom,art";
	qcom,msm-id = <0x2c3 0x10000>, <0x2c4 0x10000>;
	qcom,board-id = <0 0>;
};
