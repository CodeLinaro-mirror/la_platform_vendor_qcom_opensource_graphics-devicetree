// SPDX-License-Identifier: BSD-3-Clause
/*
 * Copyright (c) Qualcomm Technologies, Inc. and/or its subsidiaries.
 */

/dts-v1/;
/plugin/;

#include <dt-bindings/clock/qcom,aop-qmp.h>
#include <dt-bindings/clock/qcom,gcc-sm8450.h>
#include <dt-bindings/clock/qcom,sm8450-gpucc.h>
#include <dt-bindings/clock/qcom,rpmh.h>
#include <dt-bindings/interconnect/qcom,waipio.h>
#include <dt-bindings/interrupt-controller/arm-gic.h>
#include <dt-bindings/regulator/qcom,rpmh-regulator-levels.h>

#include "waipio-v2-gpu.dtsi"
#include "waipio-v2-gpu-pwrlevels.dtsi"

/ {
	model = "Qualcomm Technologies, Inc. Waipio v2";
	compatible = "qcom,waipio", "qcom,waipiop";
	qcom,msm-id = <457 0x20000>, <482 0x20000>;
	qcom,board-id = <0 0>, <1 0>, <8 0>;
};
