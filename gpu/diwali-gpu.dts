// SPDX-License-Identifier: BSD-3-Clause
/*
 * Copyright (c) Qualcomm Technologies, Inc. and/or its subsidiaries.
 */

/dts-v1/;
/plugin/;

#include <dt-bindings/clock/qcom,aop-qmp.h>
#include <dt-bindings/clock/qcom,fillmore-gcc.h>
#include <dt-bindings/clock/qcom,gpucc-diwali.h>
#include <dt-bindings/clock/qcom,rpmh.h>
#include <dt-bindings/interconnect/qcom,diwali.h>
#include <dt-bindings/interrupt-controller/arm-gic.h>
#include <dt-bindings/regulator/qcom,rpmh-regulator-levels.h>

#include "diwali-gpu.dtsi"
#include "diwali-gpu-pwrlevels.dtsi"

/ {
	model = "Qualcomm Technologies, Inc. Diwali";
	compatible = "qcom,diwali", "qcom,diwali-lte", "qcom,diwalip";
	qcom,msm-id = <506 0x10000>, <564 0x10000>, <547 0x10000>;
	qcom,board-id = <0 0>, <34 2>;
};
